## boards/shields/corne/Kconfig.shield
```kconfig
config SHIELD_CORNE_CENTRAL_DONGLE
    def_bool $(shields_list_contains,corne_central_dongle)

config SHIELD_CORNE_LEFT
    def_bool $(shields_list_contains,corne_left)

config SHIELD_CORNE_RIGHT
    def_bool $(shields_list_contains,corne_right)
```
