#include <behaviors.dtsi>
#include <dt-bindings/zmk/keys.h>

/ {
    keymap {
        compatible = "zmk,keymap";

        default_layer {
            sensor-bindings = <&inc_dec_kp N1 N0>;

            bindings = <&kp Q>;
        };
    };
};
